// SPDX-License-Identifier: GPL-2.0
/dts-v1/;

#include "tegra210b01-nx.dtsi"

/ {
	model = "Nintendo Switch (OLED model)";
	compatible = "nvidia,fric", "nintendo,aula", "nintendo,nx", "nvidia,tegra210b01", "nvidia,tegra210";
};
